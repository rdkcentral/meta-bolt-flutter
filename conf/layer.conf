## conf/layer.conf
```bitbake
BBPATH .= ":${LAYERDIR}"
BBPATH .= ":${LAYERDIR}/deps/meta-clang"
BBPATH .= ":${LAYERDIR}/deps/meta-flutter"
BBPATH .= ":${LAYERDIR}/deps/meta-flutter/lib"
BBPATH .= ":${LAYERDIR}/deps/meta-flutter/tools"
BBPATH .= ":${LAYERDIR}/deps/meta-flutter/meta-flutter-apps"

BBLAYERS_DYNAMIC += "clang-layer:${LAYERDIR}/dynamic-layers/meta-clang"

BBFILES += "${LAYERDIR}/recipes-*/*/*.bb \
            ${LAYERDIR}/recipes-*/*/*/*.bb \
            ${LAYERDIR}/recipes-*/*/*.bbappend \
            ${LAYERDIR}/classes/*.bbclass"

BBFILES += "${LAYERDIR}/deps/meta-clang/recipes-devtools/clang/*.bb"


BBFILES += "${LAYERDIR}/deps/meta-flutter/recipes-graphics/*/*.bb \
            ${LAYERDIR}/deps/meta-flutter/recipes-devtools/*/*.bb \
            ${LAYERDIR}/deps/meta-flutter/recipes-platform/*/*.bb \
            ${LAYERDIR}/deps/meta-flutter/meta-flutter-apps/*/*.bb \
            ${LAYERDIR}/deps/meta-flutter/meta-flutter-apps/*/*/*.bb \
            ${LAYERDIR}/deps/meta-flutter/meta-flutter-apps/*/*/*/*.bb \
           "

BBFILE_COLLECTIONS += "meta-bolt-flutter"
BBFILE_PATTERN_meta-bolt-flutter = "^${LAYERDIR}/"
BBFILE_PRIORITY_meta-bolt-flutter = "10"

LAYERDEPENDS_meta-bolt-flutter = "bolt-base"
LAYERSERIES_COMPAT_meta-bolt-flutter = "kirkstone"

#flutter-engine recipe requires this or won't build 
# see https://github.com/meta-flutter/meta-flutter/blob/kirkstone/recipes-graphics/flutter-engine/flutter-engine_git.bb#L14
#solving like this for now but need to check for better solution
DISTRO_FEATURES:append = " opengl"

#toyota flutter embedder version
PREFERRED_VERSION_flutter-auto = "2.%"

#workaround for Sonny embedder depending on gawk GPLv3, falling back to GPLv2 version
PREFERRED_VERSION_gawk = "3.1.5"

#MIDDLEWARE_ARCH ??= "${TUNE_PKGARCH}"

#BBMULTICONFIG:remove = "arm64"
#BBMULTICONFIG:remove = "amd64"

CMF_GITHUB_ROOT ?= "git://github.com/rdkcentral"
CMF_GITHUB_PROTOCOL = "https"
CMF_GITHUB_BRANCH = "nobranch=1"
CMF_GITHUB_SRC_URI_SUFFIX = "protocol=${CMF_GITHUB_PROTOCOL};${CMF_GITHUB_BRANCH}"
```
